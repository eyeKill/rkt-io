## src/dpdk/defconfig
```kconfig
CONFIG_RTE_BACKTRACE=n
CONFIG_RTE_APP_TEST=n
CONFIG_RTE_TEST_PMD=n
CONFIG_RTE_TEST_BBDEV=n
CONFIG_RTE_APP_COMPRESS_PERF=n
CONFIG_RTE_APP_CRYPTO_PERF=n
CONFIG_RTE_APP_EVENTDEV=n
CONFIG_RTE_LIBRTE_PDUMP=n
CONFIG_RTE_PROC_INFO=n
```

## src/dpdk/override/defconfig
```kconfig
# this requires glibc
CONFIG_RTE_BACKTRACE=n

# disable applications/examples
CONFIG_RTE_APP_TEST=n
CONFIG_RTE_TEST_PMD=n
CONFIG_RTE_TEST_BBDEV=n
CONFIG_RTE_APP_COMPRESS_PERF=n
CONFIG_RTE_APP_CRYPTO_PERF=n
CONFIG_RTE_APP_EVENTDEV=n
CONFIG_RTE_LIBRTE_PDUMP=n
CONFIG_RTE_PROC_INFO=n
CONFIG_RTE_LIBRTE_TIMER=n
CONFIG_RTE_LIBRTE_POWER=n

# some unnecessary features
CONFIG_RTE_LIBRTE_IPSEC=n
CONFIG_RTE_LIBRTE_CRYPTODEV=n
CONFIG_RTE_LIBRTE_BBDEV=n
CONFIG_RTE_LIBRTE_BPF=n
CONFIG_RTE_LIBRTE_COMPRESSDEV=n
CONFIG_RTE_LIBRTE_VHOST=n
CONFIG_RTE_LIBRTE_EVENTDEV=n
CONFIG_RTE_LIBRTE_SECURITY=n
CONFIG_RTE_LIBRTE_PORT=n
CONFIG_RTE_LIBRTE_TABLE=n
CONFIG_RTE_LIBRTE_ACL=n
CONFIG_RTE_LIBRTE_PIPELINE=n
CONFIG_RTE_LIBRTE_FLOW_CLASSIFY=n
CONFIG_RTE_LIBRTE_COMMON_DPAAX=n

# my hardware
CONFIG_RTE_LIBRTE_I40E_PMD=y
CONFIG_RTE_LIBRTE_VDEV_BUS=y
CONFIG_RTE_LIBRTE_PMD_RING=y

# some unnecessary hardware (at least for me)
CONFIG_RTE_LIBRTE_ARK_PMD=n
CONFIG_RTE_LIBRTE_ATLANTIC_PMD=n
CONFIG_RTE_LIBRTE_AXGBE_PMD=n
CONFIG_RTE_LIBRTE_BNX2X_PMD=n
CONFIG_RTE_LIBRTE_BNXT_PMD=n
CONFIG_RTE_LIBRTE_CXGBE_PMD=n
CONFIG_RTE_LIBRTE_DPAA_PMD=n
CONFIG_RTE_LIBRTE_DPAA2_PMD=n
CONFIG_RTE_LIBRTE_ENETC_PMD=n
CONFIG_RTE_LIBRTE_ENA_PMD=n
CONFIG_RTE_LIBRTE_ENIC_PMD=n
CONFIG_RTE_LIBRTE_EM_PMD=n
CONFIG_RTE_LIBRTE_IGB_PMD=n
CONFIG_RTE_LIBRTE_IXGBE_PMD=n
CONFIG_RTE_LIBRTE_FM10K_PMD=n
CONFIG_RTE_LIBRTE_FSLMC_BUS=n
CONFIG_RTE_LIBRTE_DPAA_BUS=n
CONFIG_RTE_LIBRTE_IFPGA_BUS=n
CONFIG_RTE_LIBRTE_ICE_PMD=n
CONFIG_RTE_LIBRTE_AVF_PMD=n
CONFIG_RTE_LIBRTE_MLX4_PMD=n
CONFIG_RTE_LIBRTE_MLX5_PMD=n
CONFIG_RTE_LIBRTE_VMBUS=n
CONFIG_RTE_LIBRTE_NFP_PMD=n
CONFIG_RTE_LIBRTE_QEDE_PMD=n
CONFIG_RTE_LIBRTE_SFC_EFX_PMD=n
CONFIG_RTE_LIBRTE_PMD_SZEDATA2=n
CONFIG_RTE_LIBRTE_THUNDERX_NICVF_PMD=n
CONFIG_RTE_LIBRTE_LIO_PMD=n
CONFIG_RTE_LIBRTE_OCTEONTX_PMD=n
CONFIG_RTE_LIBRTE_AVP_PMD=n
CONFIG_RTE_LIBRTE_VIRTIO_PMD=n
CONFIG_RTE_LIBRTE_VMXNET3_PMD=n
CONFIG_RTE_LIBRTE_PMD_AF_PACKET=n
CONFIG_RTE_LIBRTE_PMD_BOND=n
CONFIG_RTE_LIBRTE_MVPP2_PMD=n
CONFIG_RTE_LIBRTE_MVNETA_PMD=n
CONFIG_RTE_LIBRTE_NETVSC_PMD=n
CONFIG_RTE_LIBRTE_VDEV_NETVSC_PMD=n
CONFIG_RTE_LIBRTE_PMD_NULL=n
CONFIG_RTE_LIBRTE_PMD_PCAP=n
CONFIG_RTE_LIBRTE_PMD_SOFTNIC=n
CONFIG_RTE_LIBRTE_PMD_TAP=n
CONFIG_RTE_LIBRTE_PMD_BBDEV_NULL=n
CONFIG_RTE_LIBRTE_PMD_BBDEV_TURBO_SW=n
CONFIG_RTE_LIBRTE_PMD_ARMV8_CRYPTO=n
CONFIG_RTE_LIBRTE_PMD_ARMV8_CRYPTO_DEBUG=n
CONFIG_RTE_LIBRTE_PMD_CAAM_JR=y
CONFIG_RTE_LIBRTE_PMD_CAAM_JR_BE=n
CONFIG_RTE_LIBRTE_PMD_DPAA2_SEC=n
CONFIG_RTE_LIBRTE_PMD_DPAA_SEC=n
CONFIG_RTE_LIBRTE_PMD_OCTEONTX_CRYPTO=y
CONFIG_RTE_LIBRTE_PMD_QAT=n
CONFIG_RTE_LIBRTE_PMD_QAT_SYM=n
CONFIG_RTE_LIBRTE_PMD_VIRTIO_CRYPTO=n
CONFIG_RTE_LIBRTE_PMD_AESNI_MB=n
CONFIG_RTE_LIBRTE_PMD_OPENSSL=n
CONFIG_RTE_LIBRTE_PMD_AESNI_GCM=n
CONFIG_RTE_LIBRTE_PMD_IFPGA_RAWDEV=n
CONFIG_RTE_LIBRTE_OCTEONTX_MEMPOOL=n
CONFIG_RTE_LIBRTE_PMD_SNOW3G=n
CONFIG_RTE_LIBRTE_PMD_SNOW3G_DEBUG=n
CONFIG_RTE_LIBRTE_PMD_KASUMI=n
CONFIG_RTE_LIBRTE_PMD_ZUC=n
CONFIG_RTE_LIBRTE_PMD_CRYPTO_SCHEDULER=n
CONFIG_RTE_LIBRTE_PMD_NULL_CRYPTO=n
CONFIG_RTE_LIBRTE_PMD_CCP=n
CONFIG_RTE_LIBRTE_PMD_MVSAM_CRYPTO=n
CONFIG_RTE_LIBRTE_PMD_OCTEONTX_ZIPVF=n
CONFIG_RTE_LIBRTE_PMD_ISAL=n
CONFIG_RTE_LIBRTE_PMD_ZLIB=n
CONFIG_RTE_LIBRTE_PMD_KNI=n
CONFIG_RTE_LIBRTE_PMD_VHOST=n
CONFIG_RTE_LIBRTE_IFC_PMD=n
CONFIG_RTE_LIBRTE_PMD_FAILSAFE=n
CONFIG_RTE_LIBRTE_RAWDEV=n
CONFIG_RTE_EAL_NUMA_AWARE_HUGEPAGES=n
CONFIG_RTE_LIBRTE_VHOST_NUMA=n
CONFIG_RTE_MAX_MEMSEG_LISTS=1
CONFIG_RTE_MAX_MEMSEG_PER_LIST=32768
CONFIG_RTE_MAX_MEM_MB_PER_LIST=65536
CONFIG_RTE_EAL_IGB_UIO=n
CONFIG_RTE_KNI_KMOD=n
```
